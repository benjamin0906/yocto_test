## build/conf/bblayers.conf
```bitbake
# POKY_BBLAYERS_CONF_VERSION is increased each time build/conf/bblayers.conf
# changes incompatibly
POKY_BBLAYERS_CONF_VERSION = "2"

BBPATH = "${TOPDIR}"
BBFILES ?= ""

ROOTPATH = "${@os.path.abspath("${TOPDIR}/../")}"
#ROOTPATH = "/home/u29h63/yocto_test"

BBLAYERS ?= " \
  ${ROOTPATH}/poky/meta \
  ${ROOTPATH}/poky/meta-poky \
  ${ROOTPATH}/poky/meta-yocto-bsp \
  ${ROOTPATH}/meta-openembedded/meta-oe \
  ${ROOTPATH}/meta-raspberrypi \
  ${ROOTPATH}/meta-qt5 \
  ${ROOTPATH}/meta-opendash \
  /home/benjamin/yocto_test/build/workspace \
  "
```

## meta-rpilinux/conf/layer.conf
```bitbake
BBPATH .= ":${LAYERDIR}"
BBFILES += "${LAYERDIR}/recipes-*/*/*.bb "
BBFILES += "${LAYERDIR}/recipes-*/*/*.bbappend "
BBFILES += "${LAYERDIR}/recipes-*/*.bb "
BBFILES += "${LAYERDIR}/recipes-*/*.bbappend "

BBFILE_COLLECTIONS += "rpilinux"
BBFILE_PATTERN_rpilinux = "^${LAYERDIR}/"
BBFILE_PRIORITY_rpilinux = "6"

LAYERSERIES_COMPAT_rpilinux = "walnascar"

ENABLE_SPI_BUS="1"
ENABLE_I2C="1"

KERNEL_MODULE_AUTOLOAD:rpi += "i2c-dev i2c-bcm2835"
KERNEL_MODULE_AUTOLOAD:rpi += "spidev spi-bcm2835"
```
